#include <gtest/gtest.h>

#include <algorithm>
#include <array>
#include <cmath>
#include <cstdint>
#include <cstring>
#include <memory>
#include <string>
#include <utility>
#include <vector>

#include "esphome/components/http_request/http_request.h"
#include "esphome/components/online_image/online_image.h"
#include "esphome/core/application.h"
#include "esphome/core/hal.h"

namespace esphome::online_image::testing {

// Serves a fixed body, handing out at most `available` bytes of it.
class FakeContainer : public http_request::HttpContainer {
 public:
  FakeContainer(std::vector<uint8_t> body, size_t available, bool chunked)
      : body_(std::move(body)), available_(std::min(available, this->body_.size())) {
    this->status_code = 200;
    this->content_length = chunked ? 0 : this->body_.size();
    this->set_chunked(chunked);
  }

  int read(uint8_t *buf, size_t max_len) override {
    this->largest_read = std::max(this->largest_read, max_len);
    if (this->read_error_)
      return -1;
    size_t len = std::min(max_len, this->available_ - this->bytes_read_);
    std::memcpy(buf, this->body_.data() + this->bytes_read_, len);
    this->bytes_read_ += len;
    return static_cast<int>(len);
  }
  void end() override {}

  // Like ESP-IDF: a chunked response is complete once its last chunk has been read
  bool is_read_complete() const override {
    if (this->is_chunked_)
      return this->bytes_read_ >= this->body_.size();
    return HttpContainer::is_read_complete();
  }

  void set_content_length(size_t length) { this->content_length = length; }
  /// Make every read from now on fail, like a dropped connection
  void fail_reads() { this->read_error_ = true; }
  /// Let len more bytes of the body arrive
  void deliver(size_t len) { this->available_ = std::min(this->body_.size(), this->available_ + len); }
  void add_response_header(const std::string &name, const std::string &value) {
    this->response_headers_.push_back({name, value});
  }

  /// The most bytes any one read() asked for
  size_t largest_read{0};

 protected:
  std::vector<uint8_t> body_;
  size_t available_;
  bool read_error_{false};
};

class FakeHttpRequest : public http_request::HttpRequestComponent {
 public:
  std::shared_ptr<http_request::HttpContainer> next;
  std::vector<http_request::Header> sent_headers;

  bool sent_header(const std::string &name) const {
    return std::any_of(this->sent_headers.begin(), this->sent_headers.end(),
                       [&name](const http_request::Header &header) { return header.name == name; });
  }

 protected:
  std::shared_ptr<http_request::HttpContainer> perform(const char *url, const char *method, const std::string &body,
                                                       const std::vector<http_request::Header> &request_headers,
                                                       const std::vector<std::string> &collect_headers,
                                                       uint32_t timeout) override {
    this->sent_headers = request_headers;
    return std::move(this->next);
  }
};

// A 24-bit BMP, 2x2 pixels: 54 header bytes, then two rows of 6 pixel bytes and 2 padding bytes.
static constexpr size_t BMP_HEADER_SIZE = 54;
static constexpr size_t BMP_ROW_SIZE = 8;

static std::vector<uint8_t> make_bmp() {
  std::vector<uint8_t> bmp(BMP_HEADER_SIZE + 2 * BMP_ROW_SIZE, 0);
  auto put32 = [&bmp](size_t offset, uint32_t value) {
    for (size_t i = 0; i < 4; i++)
      bmp[offset + i] = (value >> (8 * i)) & 0xFF;
  };
  bmp[0] = 'B';
  bmp[1] = 'M';
  put32(2, bmp.size());
  put32(10, BMP_HEADER_SIZE);
  put32(14, 40);  // DIB header size
  put32(18, 2);   // width
  put32(22, 2);   // height
  bmp[26] = 1;    // color planes
  bmp[28] = 24;   // bits per pixel
  return bmp;
}

// An 8x8, 8-bit BMP whose 256-color table puts the pixels at offset 1078, past a 256 byte buffer.
static std::vector<uint8_t> make_palette_bmp() {
  constexpr size_t data_offset = 14 + 40 + 256 * 4;
  std::vector<uint8_t> bmp(data_offset + 8 * 8, 0);
  auto put32 = [&bmp](size_t offset, uint32_t value) {
    for (size_t i = 0; i < 4; i++)
      bmp[offset + i] = (value >> (8 * i)) & 0xFF;
  };
  bmp[0] = 'B';
  bmp[1] = 'M';
  put32(2, bmp.size());
  put32(10, data_offset);
  put32(14, 40);   // DIB header size
  put32(18, 8);    // width
  put32(22, 8);    // height
  bmp[26] = 1;     // color planes
  bmp[28] = 8;     // bits per pixel
  put32(34, 64);   // image size
  put32(46, 256);  // colors in the table
  return bmp;
}

// A 1x1 RGB PNG: 8 signature bytes, a 25 byte IHDR chunk, a 24 byte IDAT chunk and a 12 byte IEND chunk.
static constexpr size_t PNG_HEADER_SIZE = 8 + 25;
static constexpr std::array<uint8_t, 69> PNG_1X1{
    0x89, 0x50, 0x4E, 0x47, 0x0D, 0x0A, 0x1A, 0x0A, 0x00, 0x00, 0x00, 0x0D, 0x49, 0x48, 0x44, 0x52, 0x00, 0x00,
    0x00, 0x01, 0x00, 0x00, 0x00, 0x01, 0x08, 0x02, 0x00, 0x00, 0x00, 0x90, 0x77, 0x53, 0xDE, 0x00, 0x00, 0x00,
    0x0C, 0x49, 0x44, 0x41, 0x54, 0x78, 0x9C, 0x63, 0xF8, 0xCF, 0xC0, 0x00, 0x00, 0x03, 0x01, 0x01, 0x00, 0xC9,
    0xFE, 0x92, 0xEF, 0x00, 0x00, 0x00, 0x00, 0x49, 0x45, 0x4E, 0x44, 0xAE, 0x42, 0x60, 0x82};

// 8x8 progressive JPEG, 521 bytes
static const uint8_t JPEG_PROGRESSIVE[] = {
    0xFF, 0xD8, 0xFF, 0xE0, 0x00, 0x10, 0x4A, 0x46, 0x49, 0x46, 0x00, 0x01, 0x01, 0x00, 0x00, 0x01, 0x00, 0x01, 0x00,
    0x00, 0xFF, 0xDB, 0x00, 0x43, 0x00, 0x10, 0x0B, 0x0C, 0x0E, 0x0C, 0x0A, 0x10, 0x0E, 0x0D, 0x0E, 0x12, 0x11, 0x10,
    0x13, 0x18, 0x28, 0x1A, 0x18, 0x16, 0x16, 0x18, 0x31, 0x23, 0x25, 0x1D, 0x28, 0x3A, 0x33, 0x3D, 0x3C, 0x39, 0x33,
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    0x01, 0x00, 0x01, 0x3F, 0x10, 0x7F, 0xFF, 0xD9,
};

// 48x40 4:2:0 JPEG (quality 95), 2344 bytes: three rows of 16 pixel MCUs, with the scan starting at byte 609
static const uint8_t JPEG_48X40[] = {
    0xFF, 0xD8, 0xFF, 0xE0, 0x00, 0x10, 0x4A, 0x46, 0x49, 0x46, 0x00, 0x01, 0x01, 0x00, 0x00, 0x01, 0x00, 0x01, 0x00,
    0x00, 0xFF, 0xDB, 0x00, 0x43, 0x00, 0x02, 0x01, 0x01, 0x01, 0x01, 0x01, 0x02, 0x01, 0x01, 0x01, 0x02, 0x02, 0x02,
    0x02, 0x02, 0x04, 0x03, 0x02, 0x02, 0x02, 0x02, 0x05, 0x04, 0x04, 0x03, 0x04, 0x06, 0x05, 0x06, 0x06, 0x06, 0x05,
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    0x7A, 0xBF, 0x5E, 0xB7, 0x3F, 0xFF, 0xD9,
};

static void set_loop_time(uint32_t now) { LoopBlockingGuard clock(nullptr, LOG_STR("test"), now); }

class OnlineImageDownloadEnd : public ::testing::Test {
 protected:
  std::unique_ptr<OnlineImage> make_image_(runtime_image::ImageFormat format, uint32_t buffer_size = 256) {
    auto img = std::make_unique<OnlineImage>("http://example.com/image", 0, 0, format, image::IMAGE_TYPE_RGB,
                                             image::TRANSPARENCY_OPAQUE, nullptr, buffer_size);
    img->set_parent(&this->http_);
    return img;
  }

  void start_(OnlineImage &image, const std::shared_ptr<FakeContainer> &container) {
    image.add_on_finished_callback([this](bool) { this->finished_++; });
    image.add_on_error_callback([this]() { this->errors_++; });
    this->http_.next = container;
    image.update();
  }

  FakeHttpRequest http_;
  int finished_{0};
  int errors_{0};
};

// A chunked stream can end without the decoder reporting it is finished. PNG cannot tell a
// complete image from a cut-off one, so when the decoder used every byte the download succeeds,
// but the image is not cached: a 304 response must not keep it.
TEST_F(OnlineImageDownloadEnd, ChunkedPngCutOffFinishesWithoutCaching) {
  std::vector<uint8_t> png(PNG_1X1.begin(), PNG_1X1.begin() + PNG_HEADER_SIZE);  // ends after IHDR
  auto container = std::make_shared<FakeContainer>(png, png.size(), true);
  container->add_response_header("etag", "\"abc\"");
  container->add_response_header("last-modified", "Mon, 12 Oct 2026 10:00:00 GMT");
  auto image = this->make_image_(runtime_image::PNG);
  this->start_(*image, container);

  for (int i = 0; i < 4 && this->finished_ + this->errors_ == 0; i++)
    image->loop();

  EXPECT_EQ(this->finished_, 1);
  EXPECT_EQ(this->errors_, 0);

  this->http_.next = std::make_shared<FakeContainer>(png, 0, false);
  image->update();
  EXPECT_FALSE(this->http_.sent_header("if-none-match"));
  EXPECT_FALSE(this->http_.sent_header("if-modified-since"));
}

// BMP knows its pixel count from the header, so a chunked BMP cut off at a row boundary is an error.
TEST_F(OnlineImageDownloadEnd, ChunkedBmpCutOffAtRowReportsError) {
  std::vector<uint8_t> bmp = make_bmp();
  bmp.resize(BMP_HEADER_SIZE + BMP_ROW_SIZE);  // only the first row
  auto container = std::make_shared<FakeContainer>(bmp, bmp.size(), true);
  auto image = this->make_image_(runtime_image::BMP);
  this->start_(*image, container);

  for (int i = 0; i < 4 && this->finished_ + this->errors_ == 0; i++)
    image->loop();

  EXPECT_EQ(this->errors_, 1);
  EXPECT_EQ(this->finished_, 0);
}

// An image the decoder confirmed as complete is cached.
TEST_F(OnlineImageDownloadEnd, CompleteImageIsCached) {
  std::vector<uint8_t> bmp = make_bmp();
  auto container = std::make_shared<FakeContainer>(bmp, bmp.size(), false);
  container->add_response_header("etag", "\"abc\"");
  container->add_response_header("last-modified", "Mon, 12 Oct 2026 10:00:00 GMT");
  auto image = this->make_image_(runtime_image::BMP);
  this->start_(*image, container);

  for (int i = 0; i < 4 && this->finished_ + this->errors_ == 0; i++)
    image->loop();
  ASSERT_EQ(this->finished_, 1);

  this->http_.next = std::make_shared<FakeContainer>(bmp, 0, false);
  image->update();
  EXPECT_TRUE(this->http_.sent_header("if-none-match"));
  EXPECT_TRUE(this->http_.sent_header("if-modified-since"));
}

// ESP-IDF keeps returning 0 after the server closes the connection early.
TEST_F(OnlineImageDownloadEnd, NoDataForTimeoutReportsError) {
  this->http_.set_timeout(100);
  auto container = std::make_shared<FakeContainer>(make_bmp(), 20, false);
  auto image = this->make_image_(runtime_image::BMP);
  this->start_(*image, container);

  const uint32_t now = millis();
  set_loop_time(now);
  image->loop();
  ASSERT_EQ(container->get_bytes_read(), 20u);
  set_loop_time(now + 99);
  image->loop();
  EXPECT_EQ(this->errors_, 0);

  set_loop_time(now + 100);
  image->loop();
  EXPECT_EQ(this->errors_, 1);
  EXPECT_EQ(this->finished_, 0);
}

// The time spent connecting and reading the headers must not count as time without data.
TEST_F(OnlineImageDownloadEnd, NoDataTimeoutStartsAfterRequest) {
  this->http_.set_timeout(100);
  auto container = std::make_shared<FakeContainer>(make_bmp(), 0, false);
  auto image = this->make_image_(runtime_image::BMP);
  // update() runs in a dispatch that started before the blocking request, here one second earlier
  set_loop_time(millis() - 1000);
  this->start_(*image, container);

  const uint32_t now = millis();
  set_loop_time(now);
  image->loop();
  EXPECT_EQ(this->errors_, 0);

  set_loop_time(now + 100);
  image->loop();
  EXPECT_EQ(this->errors_, 1);
}

// A full buffer the decoder cannot use waits for the no-data timeout before it fails, so a decoder
// that only had to wait is not cut off early.
TEST_F(OnlineImageDownloadEnd, FullBufferFailsAfterTimeout) {
  this->http_.set_timeout(100);
  auto bmp = make_palette_bmp();
  auto container = std::make_shared<FakeContainer>(bmp, bmp.size(), false);
  auto image = this->make_image_(runtime_image::BMP);
  this->start_(*image, container);

  const uint32_t now = millis();
  set_loop_time(now);
  for (int i = 0; i < 8; i++)
    image->loop();
  EXPECT_EQ(this->errors_, 0);
  set_loop_time(now + 99);
  image->loop();
  EXPECT_EQ(this->errors_, 0);

  set_loop_time(now + 100);
  image->loop();
  EXPECT_EQ(this->errors_, 1);
  EXPECT_EQ(this->finished_, 0);
}

// A JPEG too big for the heap must fail, and the next download must get the configured buffer back.
TEST_F(OnlineImageDownloadEnd, JpegBufferAllocationFailureReportsError) {
  auto image = this->make_image_(runtime_image::JPEG);
  auto huge = std::make_shared<FakeContainer>(std::vector<uint8_t>(16), 16, false);
  huge->set_content_length(SIZE_MAX / 2);
  this->start_(*image, huge);
  EXPECT_EQ(this->errors_, 1);

  // A chunked response does not resize the buffer. The body is not a real JPEG, so the decoder
  // rejects it, but only once it has been read into the buffer.
  auto next = std::make_shared<FakeContainer>(std::vector<uint8_t>(100, 0xAA), 100, true);
  this->http_.next = next;
  image->update();
  image->loop();
  EXPECT_EQ(next->get_bytes_read(), 100u);
  EXPECT_EQ(this->errors_, 2);
  EXPECT_EQ(this->finished_, 0);
}

// The JPEG decoded with all of it in memory at once, to compare the downloaded images with
static std::vector<uint8_t> reference_jpeg_pixels() {
  runtime_image::RuntimeImage ref(runtime_image::JPEG, image::IMAGE_TYPE_RGB, image::TRANSPARENCY_OPAQUE);
  std::vector<uint8_t> data(JPEG_48X40, JPEG_48X40 + sizeof(JPEG_48X40));
  EXPECT_TRUE(ref.begin_decode(data.size()));
  EXPECT_EQ(ref.feed_data(data.data(), data.size()), static_cast<int>(data.size()));
  EXPECT_TRUE(ref.end_decode());
  return std::vector<uint8_t>(ref.get_data_start(), ref.get_data_start() + ref.get_width_stride() * ref.get_height());
}

static std::vector<uint8_t> image_pixels(OnlineImage &image) {
  return std::vector<uint8_t>(image.get_data_start(),
                              image.get_data_start() + image.get_width_stride() * image.get_height());
}

// A JPEG of known size is decoded as it arrives, so a buffer smaller than the file only has to hold the headers
TEST_F(OnlineImageDownloadEnd, JpegDecodesThroughASmallBuffer) {
  auto image = this->make_image_(runtime_image::JPEG, 1024);
  // Bytes after the image are never needed. Waiting for the whole file before decoding would read them all.
  std::vector<uint8_t> body(JPEG_48X40, JPEG_48X40 + sizeof(JPEG_48X40));
  body.resize(body.size() + 8192, 0);
  auto container = std::make_shared<FakeContainer>(body, body.size(), false);
  container->add_response_header("etag", "\"abc\"");
  this->start_(*image, container);

  for (int i = 0; i < 100 && this->finished_ + this->errors_ == 0; i++)
    image->loop();

  ASSERT_EQ(this->finished_, 1);
  EXPECT_LT(container->get_bytes_read(), body.size()) << "the image was not decoded as it arrived";
  EXPECT_EQ(this->errors_, 0);
  ASSERT_EQ(image->get_width(), 48);
  ASSERT_EQ(image->get_height(), 40);
  EXPECT_EQ(image_pixels(*image), reference_jpeg_pixels());

  // A complete image is cached
  this->http_.next = std::make_shared<FakeContainer>(std::vector<uint8_t>{}, 0, false);
  image->update();
  EXPECT_TRUE(this->http_.sent_header("if-none-match"));
}

// A read() waits for every byte it asks for, so a large buffer is filled a little at a time rather than in one
// read that blocks the loop until the whole buffer has arrived
TEST_F(OnlineImageDownloadEnd, JpegReadsInSmallPiecesWithALargeBuffer) {
  auto image = this->make_image_(runtime_image::JPEG, 65536);
  auto container =
      std::make_shared<FakeContainer>(std::vector<uint8_t>(JPEG_48X40, JPEG_48X40 + sizeof(JPEG_48X40)), 0, false);
  this->start_(*image, container);

  for (int i = 0; i < 100 && this->finished_ + this->errors_ == 0; i++) {
    container->deliver(sizeof(JPEG_48X40));
    image->loop();
  }

  ASSERT_EQ(this->finished_, 1);
  EXPECT_EQ(this->errors_, 0);
  EXPECT_LE(container->largest_read, STREAM_READ_CHUNK);
  EXPECT_EQ(image_pixels(*image), reference_jpeg_pixels());
}

// A slow link: the decoder waits part way through the image for the rest to arrive
TEST_F(OnlineImageDownloadEnd, JpegWaitsForASlowDownload) {
  auto image = this->make_image_(runtime_image::JPEG, 1024);
  auto container =
      std::make_shared<FakeContainer>(std::vector<uint8_t>(JPEG_48X40, JPEG_48X40 + sizeof(JPEG_48X40)), 1024, false);
  this->start_(*image, container);

  int passes = 0;
  for (; passes < 1000 && this->finished_ + this->errors_ == 0; passes++) {
    image->loop();
    if (passes == 5) {
      EXPECT_EQ(this->finished_, 0) << "the image cannot be finished before the rest of it arrives";
    }
    container->deliver(40);
  }

  ASSERT_EQ(this->finished_, 1);
  EXPECT_EQ(this->errors_, 0);
  EXPECT_GT(passes, 10);
  EXPECT_EQ(image_pixels(*image), reference_jpeg_pixels());
}

// A download that stops part way through times out rather than waiting for ever
TEST_F(OnlineImageDownloadEnd, JpegDownloadThatStopsTimesOut) {
  auto image = this->make_image_(runtime_image::JPEG, 1024);
  auto container =
      std::make_shared<FakeContainer>(std::vector<uint8_t>(JPEG_48X40, JPEG_48X40 + sizeof(JPEG_48X40)), 1500, false);
  set_loop_time(1000);
  this->start_(*image, container);

  for (int i = 0; i < 10; i++)
    image->loop();
  EXPECT_EQ(this->errors_, 0) << "still within the timeout";

  set_loop_time(1000 + this->http_.get_timeout());
  image->loop();
  EXPECT_EQ(this->errors_, 1);
  EXPECT_EQ(this->finished_, 0);
}

// Headers that do not fit the download buffer cannot be read as the image arrives, so the whole image is
// downloaded first, keeping the bytes already read
TEST_F(OnlineImageDownloadEnd, JpegHeadersLargerThanTheBufferDownloadTheWholeImage) {
  auto image = this->make_image_(runtime_image::JPEG, 256);
  auto container = std::make_shared<FakeContainer>(std::vector<uint8_t>(JPEG_48X40, JPEG_48X40 + sizeof(JPEG_48X40)),
                                                   sizeof(JPEG_48X40), false);
  this->start_(*image, container);

  for (int i = 0; i < 100 && this->finished_ + this->errors_ == 0; i++) {
    image->loop();
    container->deliver(256);
  }

  ASSERT_EQ(this->finished_, 1);
  EXPECT_EQ(this->errors_, 0);
  EXPECT_EQ(container->get_bytes_read(), sizeof(JPEG_48X40));
  EXPECT_EQ(image_pixels(*image), reference_jpeg_pixels());
}

// The pass that opens the image does not decode any of it
TEST_F(OnlineImageDownloadEnd, JpegOpensInAPassOfItsOwn) {
  auto image = this->make_image_(runtime_image::JPEG, 1024);
  auto container = std::make_shared<FakeContainer>(std::vector<uint8_t>(JPEG_48X40, JPEG_48X40 + sizeof(JPEG_48X40)),
                                                   sizeof(JPEG_48X40), false);
  this->start_(*image, container);

  image->loop();
  EXPECT_EQ(this->finished_ + this->errors_, 0);
  for (int i = 0; i < 100 && this->finished_ + this->errors_ == 0; i++)
    image->loop();
  EXPECT_EQ(this->finished_, 1);
}

// A progressive JPEG is refused while it downloads, without blaming the buffer size
TEST_F(OnlineImageDownloadEnd, JpegProgressiveReportsError) {
  auto image = this->make_image_(runtime_image::JPEG, 256);
  std::vector<uint8_t> body(JPEG_PROGRESSIVE, JPEG_PROGRESSIVE + sizeof(JPEG_PROGRESSIVE));
  auto container = std::make_shared<FakeContainer>(body, 256, false);
  this->start_(*image, container);

  for (int i = 0; i < 10 && this->finished_ + this->errors_ == 0; i++)
    image->loop();

  EXPECT_EQ(this->errors_, 1);
  EXPECT_EQ(this->finished_, 0);
}

// on_download_started fires once the server has accepted the request, before the first progress report, and not
// for a response that has no image to download
TEST_F(OnlineImageDownloadEnd, StartedFiresOnlyWhenTheDownloadBegins) {
  auto image = this->make_image_(runtime_image::JPEG, 1024);
  std::vector<std::string> events;
  image->add_on_download_started_callback([&events]() { events.emplace_back("started"); });
  image->add_on_progress_callback([&events](float, size_t) { events.emplace_back("progress"); });
  this->start_(*image,
               std::make_shared<FakeContainer>(std::vector<uint8_t>(JPEG_48X40, JPEG_48X40 + sizeof(JPEG_48X40)),
                                               sizeof(JPEG_48X40), false));
  ASSERT_GE(events.size(), 2u);
  EXPECT_EQ(events[0], "started");
  EXPECT_EQ(events[1], "progress");
  for (int i = 0; i < 100 && this->finished_ + this->errors_ == 0; i++)
    image->loop();
  EXPECT_EQ(std::count(events.begin(), events.end(), std::string("started")), 1);

  for (int status : {304, 404}) {
    events.clear();
    auto container = std::make_shared<FakeContainer>(std::vector<uint8_t>{}, 0, false);
    container->status_code = status;
    this->http_.next = container;
    image->update();
    EXPECT_TRUE(events.empty()) << "HTTP " << status;
  }
}

// Progress starts at 0, is reported at most every 100 ms, and always reaches 100%
TEST_F(OnlineImageDownloadEnd, ProgressIsReportedAsTheImageDownloads) {
  auto image = this->make_image_(runtime_image::JPEG, 1024);
  std::vector<float> reports;
  image->add_on_progress_callback([&reports](float progress, size_t) { reports.push_back(progress); });
  auto container =
      std::make_shared<FakeContainer>(std::vector<uint8_t>(JPEG_48X40, JPEG_48X40 + sizeof(JPEG_48X40)), 100, false);
  uint32_t now = 1000;
  set_loop_time(now);
  this->start_(*image, container);
  ASSERT_EQ(reports.size(), 1u);
  EXPECT_EQ(reports[0], 0.0f);

  int passes = 0;
  for (; passes < 1000 && this->finished_ + this->errors_ == 0; passes++) {
    now += 50;
    set_loop_time(now);
    container->deliver(100);
    image->loop();
  }

  ASSERT_EQ(this->finished_, 1);
  EXPECT_EQ(reports.back(), 100.0f);
  EXPECT_TRUE(std::is_sorted(reports.begin(), reports.end()));
  // A report every 100 ms of a 50 ms loop, plus the start and the end
  EXPECT_LE(reports.size(), static_cast<size_t>(passes / 2 + 2));
  EXPECT_GT(reports.size(), 3u);
}

// Without a Content-Length the percentage is unknown, but the bytes read are still reported
TEST_F(OnlineImageDownloadEnd, ProgressOfAChunkedDownloadHasNoPercentage) {
  auto image = this->make_image_(runtime_image::PNG);
  std::vector<std::pair<float, size_t>> reports;
  image->add_on_progress_callback(
      [&reports](float progress, size_t bytes_read) { reports.emplace_back(progress, bytes_read); });
  auto container =
      std::make_shared<FakeContainer>(std::vector<uint8_t>(PNG_1X1.begin(), PNG_1X1.end()), PNG_1X1.size(), true);
  set_loop_time(1000);
  this->start_(*image, container);
  set_loop_time(2000);
  for (int i = 0; i < 10 && this->finished_ + this->errors_ == 0; i++)
    image->loop();

  ASSERT_GE(reports.size(), 2u);
  EXPECT_TRUE(std::isnan(reports.back().first));
  EXPECT_EQ(reports.back().second, PNG_1X1.size());
}

// Scan data that cannot be decoded fails the download part way through
TEST_F(OnlineImageDownloadEnd, JpegDecodeErrorFailsTheDownload) {
  auto image = this->make_image_(runtime_image::JPEG, 1024);
  std::vector<uint8_t> body(JPEG_48X40, JPEG_48X40 + sizeof(JPEG_48X40));
  std::fill(body.begin() + 700, body.end() - 2, 0xFE);
  auto container = std::make_shared<FakeContainer>(body, 1024, false);
  this->start_(*image, container);

  for (int i = 0; i < 100 && this->finished_ + this->errors_ == 0; i++) {
    image->loop();
    container->deliver(256);
  }

  EXPECT_EQ(this->errors_, 1);
  EXPECT_EQ(this->finished_, 0);
}

// A read that fails part way through the download ends it with an error
TEST_F(OnlineImageDownloadEnd, JpegReadErrorFailsTheDownload) {
  auto image = this->make_image_(runtime_image::JPEG, 1024);
  auto container =
      std::make_shared<FakeContainer>(std::vector<uint8_t>(JPEG_48X40, JPEG_48X40 + sizeof(JPEG_48X40)), 1024, false);
  this->start_(*image, container);
  for (int i = 0; i < 5; i++)
    image->loop();
  ASSERT_EQ(this->errors_, 0);

  container->fail_reads();
  image->loop();
  EXPECT_EQ(this->errors_, 1);
  EXPECT_EQ(this->finished_, 0);
}

TEST(DownloadBufferGrow, KeepsTheUnreadData) {
  DownloadBuffer buffer(16);
  std::memcpy(buffer.append(), "abcdef", 6);
  buffer.write(6);
  buffer.read(2);

  ASSERT_TRUE(buffer.grow(64));
  EXPECT_EQ(buffer.size(), 64u);
  ASSERT_EQ(buffer.unread(), 4u);
  EXPECT_EQ(std::memcmp(buffer.data(), "cdef", 4), 0);

  // A failed allocation leaves the buffer as it was
  EXPECT_FALSE(buffer.grow(SIZE_MAX / 2));
  EXPECT_EQ(buffer.size(), 64u);
  EXPECT_EQ(std::memcmp(buffer.data(), "cdef", 4), 0);
  // Growing to a smaller size changes nothing
  EXPECT_TRUE(buffer.grow(8));
  EXPECT_EQ(buffer.size(), 64u);
}

}  // namespace esphome::online_image::testing
