#include <gtest/gtest.h>

#include <algorithm>
#include <cstring>
#include <vector>

#include "esphome/components/runtime_image/image_decoder.h"
#include "esphome/components/runtime_image/jpeg_decoder.h"
#include "esphome/components/runtime_image/runtime_image.h"

#ifdef USE_RUNTIME_IMAGE_JPEG

namespace esphome::runtime_image::testing {

// 48x40 4:2:0 JPEG of a noisy gradient (quality 95): three rows of 16 pixel MCUs, so a stepped decode takes
// three steps. At 2344 bytes it is larger than JPEGDEC's 2048 byte read buffer, so the source is read again
// part way through the image.
static const uint8_t JPEG_ROWS[] = {
    0xFF, 0xD8, 0xFF, 0xE0, 0x00, 0x10, 0x4A, 0x46, 0x49, 0x46, 0x00, 0x01, 0x01, 0x00, 0x00, 0x01, 0x00, 0x01, 0x00,
    0x00, 0xFF, 0xDB, 0x00, 0x43, 0x00, 0x02, 0x01, 0x01, 0x01, 0x01, 0x01, 0x02, 0x01, 0x01, 0x01, 0x02, 0x02, 0x02,
    0x02, 0x02, 0x04, 0x03, 0x02, 0x02, 0x02, 0x02, 0x05, 0x04, 0x04, 0x03, 0x04, 0x06, 0x05, 0x06, 0x06, 0x06, 0x05,
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    0x7A, 0xBF, 0x5E, 0xB7, 0x3F, 0xFF, 0xD9,
};

// JPEG_ROWS made progressive with jpegtran: the same coefficients in ten scans, so it decodes to the same pixels.
// At 2196 bytes it is also larger than JPEGDEC's read buffer.
static const uint8_t JPEG_ROWS_PROGRESSIVE[] = {
    0xFF, 0xD8, 0xFF, 0xE0, 0x00, 0x10, 0x4A, 0x46, 0x49, 0x46, 0x00, 0x01, 0x01, 0x00, 0x00, 0x01, 0x00, 0x01, 0x00,
    0x00, 0xFF, 0xDB, 0x00, 0x43, 0x00, 0x02, 0x01, 0x01, 0x01, 0x01, 0x01, 0x02, 0x01, 0x01, 0x01, 0x02, 0x02, 0x02,
    0x02, 0x02, 0x04, 0x03, 0x02, 0x02, 0x02, 0x02, 0x05, 0x04, 0x04, 0x03, 0x04, 0x06, 0x05, 0x06, 0x06, 0x06, 0x05,
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    0x19, 0xA2, 0x55, 0xAB, 0x45, 0x51, 0x3C, 0x38, 0x7F, 0xFF, 0xD9,
};

class SourceImage : public RuntimeImage {
 public:
  explicit SourceImage(image::ImageType type = image::IMAGE_TYPE_RGB, int width = 0, int height = 0)
      : RuntimeImage(JPEG, type, image::TRANSPARENCY_OPAQUE, nullptr, false, width, height) {}
  size_t decoded_bytes() const { return this->decoded_bytes_; }
  int scale() const { return static_cast<const JpegDecoder *>(this->decoder_.get())->get_scale(); }
};

/// The file in memory; fails reads once fail_at bytes have been read
class MemorySource : public DecodeSource {
 public:
  MemorySource(const uint8_t *data, size_t size, size_t fail_at = SIZE_MAX)
      : data_(data), size_(size), fail_at_(fail_at) {}
  int32_t read(uint8_t *buf, uint32_t len) override {
    if (this->pos_ >= this->fail_at_)
      return -1;
    const size_t n = std::min<size_t>(len, this->size_ - this->pos_);
    memcpy(buf, this->data_ + this->pos_, n);
    this->pos_ += n;
    this->reads++;
    return static_cast<int32_t>(n);
  }
  bool seek(uint32_t position) override {
    if (position > this->size_)
      return false;
    this->pos_ = position;
    return true;
  }
  int reads{0};

 protected:
  const uint8_t *data_;
  size_t size_;
  size_t pos_{0};
  size_t fail_at_;
};

/// Hands out only the bytes delivered so far, like a download that is still arriving
class TrickleSource : public DecodeSource {
 public:
  TrickleSource(const uint8_t *data, size_t size, size_t delivered) : data_(data), size_(size), delivered_(delivered) {}
  int32_t read(uint8_t *buf, uint32_t len) override {
    const size_t n = std::min<size_t>(len, this->delivered_ - this->pos_);
    memcpy(buf, this->data_ + this->pos_, n);
    this->pos_ += n;
    return static_cast<int32_t>(n);
  }
  bool seek(uint32_t position) override {
    if (position > this->delivered_)
      return false;
    this->pos_ = position;
    return true;
  }
  void deliver(size_t len) { this->delivered_ = std::min(this->size_, this->delivered_ + len); }

 protected:
  const uint8_t *data_;
  size_t size_;
  size_t delivered_;
  size_t pos_{0};
};

static bool decode_fed(RuntimeImage &img, const uint8_t *data = JPEG_ROWS, size_t size = sizeof(JPEG_ROWS)) {
  std::vector<uint8_t> buffer(data, data + size);
  if (!img.begin_decode(buffer.size()))
    return false;
  if (img.feed_data(buffer.data(), buffer.size()) != static_cast<int>(buffer.size()))
    return false;
  return img.end_decode();
}

/// Decodes from a source a step at a time; returns the last result and counts the steps
static int decode_stepped(RuntimeImage &img, DecodeSource &source, int &steps, size_t size = sizeof(JPEG_ROWS)) {
  steps = 0;
  if (!img.begin_decode(size) || !img.decoder_supports_source())
    return DECODE_ERROR_UNSUPPORTED_FORMAT;
  int result = img.begin_source(&source);
  if (result != 0)
    return result;
  do {
    result = img.decode_step();
    steps++;
  } while (result == DECODE_STEP_MORE);
  if (result == DECODE_STEP_DONE && !img.end_decode())
    return DECODE_ERROR_INTERNAL_DECODER_ERROR;
  return result;
}

static std::vector<uint8_t> pixels(const RuntimeImage &img) {
  const uint8_t *start = img.get_data_start();
  return std::vector<uint8_t>(start, start + img.get_width_stride() * img.get_height());
}

TEST(JpegSourceDecode, SteppedDecodeMatchesFedDecode) {
  SourceImage fed;
  ASSERT_TRUE(decode_fed(fed));

  SourceImage stepped;
  MemorySource source(JPEG_ROWS, sizeof(JPEG_ROWS));
  int steps;
  ASSERT_EQ(decode_stepped(stepped, source, steps), DECODE_STEP_DONE);
  EXPECT_EQ(steps, 3);
  ASSERT_EQ(stepped.get_width(), 48);
  ASSERT_EQ(stepped.get_height(), 40);
  EXPECT_EQ(pixels(stepped), pixels(fed));
}

TEST(JpegSourceDecode, SteppedDirectRgb565MatchesFedDecode) {
  // A fixed size that is not a whole multiple of the source exercises the scaling tables across steps
  SourceImage fed(image::IMAGE_TYPE_RGB565, 30, 25);
  ASSERT_TRUE(decode_fed(fed));

  SourceImage stepped(image::IMAGE_TYPE_RGB565, 30, 25);
  MemorySource source(JPEG_ROWS, sizeof(JPEG_ROWS));
  int steps;
  ASSERT_EQ(decode_stepped(stepped, source, steps), DECODE_STEP_DONE);
  EXPECT_EQ(pixels(stepped), pixels(fed));
}

// decodeBegin() is given the same reduced scale as decode(), and decodeRows() keeps it for every step
TEST(JpegSourceDecode, SteppedScaledDecodeMatchesFedDecode) {
  for (auto type : {image::IMAGE_TYPE_RGB565, image::IMAGE_TYPE_RGB}) {
    // 24x20 is half of 48x40, so JPEGDEC decodes at 1/2 size
    SourceImage fed(type, 24, 20);
    ASSERT_TRUE(decode_fed(fed));
    ASSERT_EQ(fed.scale(), 2);

    SourceImage stepped(type, 24, 20);
    MemorySource source(JPEG_ROWS, sizeof(JPEG_ROWS));
    int steps;
    ASSERT_EQ(decode_stepped(stepped, source, steps), DECODE_STEP_DONE);
    ASSERT_EQ(stepped.scale(), 2);
    EXPECT_EQ(pixels(stepped), pixels(fed)) << "image type " << type;
  }
}

TEST(JpegSourceDecode, WaitsForDataThatHasNotArrived) {
  SourceImage fed;
  ASSERT_TRUE(decode_fed(fed));

  // Enough for the headers (the scan starts at byte 609), then 50 bytes between steps
  SourceImage img;
  TrickleSource source(JPEG_ROWS, sizeof(JPEG_ROWS), 700);
  ASSERT_TRUE(img.begin_decode(sizeof(JPEG_ROWS)));
  ASSERT_EQ(img.begin_source(&source), 0);
  int waits = 0;
  int result;
  while ((result = img.decode_step()) == DECODE_STEP_MORE || result == DECODE_STEP_NEED_DATA) {
    if (result == DECODE_STEP_NEED_DATA)
      waits++;
    source.deliver(50);
    ASSERT_LT(waits, 1000);
  }
  ASSERT_EQ(result, DECODE_STEP_DONE);
  ASSERT_TRUE(img.end_decode());
  EXPECT_GT(waits, 0);
  EXPECT_EQ(pixels(img), pixels(fed));
}

TEST(JpegSourceDecode, ImageIsHiddenUntilTheLastStep) {
  SourceImage img;
  MemorySource source(JPEG_ROWS, sizeof(JPEG_ROWS));
  ASSERT_TRUE(img.begin_decode(sizeof(JPEG_ROWS)));
  ASSERT_EQ(img.begin_source(&source), 0);
  EXPECT_EQ(img.decode_step(), DECODE_STEP_MORE);
  EXPECT_EQ(img.get_width(), 0);
  EXPECT_EQ(img.get_data_start(), nullptr);
}

TEST(JpegSourceDecode, ReadFailureIsReportedAndTheDecoderRecovers) {
  SourceImage img;
  // The first read fills JPEGDEC's buffer, so the failure comes part way through the image data
  MemorySource failing(JPEG_ROWS, sizeof(JPEG_ROWS), 2048);
  int steps;
  EXPECT_EQ(decode_stepped(img, failing, steps), DECODE_ERROR_READ);
  EXPECT_GE(steps, 1);
  img.release();

  MemorySource source(JPEG_ROWS, sizeof(JPEG_ROWS));
  EXPECT_EQ(decode_stepped(img, source, steps), DECODE_STEP_DONE);
}

TEST(JpegSourceDecode, ReleasePartWayThroughLetsTheNextDecodeStart) {
  SourceImage img;
  MemorySource first(JPEG_ROWS, sizeof(JPEG_ROWS));
  ASSERT_TRUE(img.begin_decode(sizeof(JPEG_ROWS)));
  ASSERT_EQ(img.begin_source(&first), 0);
  ASSERT_EQ(img.decode_step(), DECODE_STEP_MORE);
  img.release();
  EXPECT_FALSE(img.is_decoding());

  MemorySource second(JPEG_ROWS, sizeof(JPEG_ROWS));
  int steps;
  EXPECT_EQ(decode_stepped(img, second, steps), DECODE_STEP_DONE);
  EXPECT_EQ(steps, 3);
}

TEST(JpegSourceDecode, FailedFirstReadIsAReadError) {
  SourceImage img;
  MemorySource failing(JPEG_ROWS, sizeof(JPEG_ROWS), 0);
  ASSERT_TRUE(img.begin_decode(sizeof(JPEG_ROWS)));
  EXPECT_EQ(img.begin_source(&failing), DECODE_ERROR_READ);
}

TEST(JpegSourceDecode, FailedSeekToTheStartIsAReadError) {
  class NoSeekSource : public MemorySource {
   public:
    using MemorySource::MemorySource;
    bool seek(uint32_t position) override { return false; }
  };
  SourceImage img;
  NoSeekSource source(JPEG_ROWS, sizeof(JPEG_ROWS));
  ASSERT_TRUE(img.begin_decode(sizeof(JPEG_ROWS)));
  EXPECT_EQ(img.begin_source(&source), DECODE_ERROR_READ);
  EXPECT_EQ(img.decode_step(), DECODE_ERROR_INVALID_TYPE);
}

// Fed and stepped, at full size and at each reduced scale JPEGDEC picks for a smaller image
TEST(JpegSourceDecode, ProgressiveImageMatchesBaseline) {
  for (int scale : {1, 2, 4, 8}) {
    for (auto type : {image::IMAGE_TYPE_RGB565, image::IMAGE_TYPE_RGB}) {
      SourceImage baseline(type, 48 / scale, 40 / scale);
      ASSERT_TRUE(decode_fed(baseline));
      ASSERT_EQ(baseline.scale(), scale);

      SourceImage fed(type, 48 / scale, 40 / scale);
      ASSERT_TRUE(decode_fed(fed, JPEG_ROWS_PROGRESSIVE, sizeof(JPEG_ROWS_PROGRESSIVE)));
      EXPECT_EQ(pixels(fed), pixels(baseline)) << "fed, scale " << scale << ", image type " << type;

      SourceImage stepped(type, 48 / scale, 40 / scale);
      MemorySource source(JPEG_ROWS_PROGRESSIVE, sizeof(JPEG_ROWS_PROGRESSIVE));
      int steps;
      ASSERT_EQ(decode_stepped(stepped, source, steps, sizeof(JPEG_ROWS_PROGRESSIVE)), DECODE_STEP_DONE);
      ASSERT_EQ(stepped.scale(), scale);
      EXPECT_EQ(pixels(stepped), pixels(baseline)) << "stepped, scale " << scale << ", image type " << type;
    }
  }
}

// An extended sequential (SOF1) frame holds what a baseline one does, so changing the marker keeps the pixels
TEST(JpegSourceDecode, ExtendedSequentialImageMatchesBaseline) {
  static const uint8_t SOF0[] = {0xFF, 0xC0};
  std::vector<uint8_t> extended(JPEG_ROWS, JPEG_ROWS + sizeof(JPEG_ROWS));
  auto sof = std::search(extended.begin(), extended.end(), std::begin(SOF0), std::end(SOF0));
  ASSERT_NE(sof, extended.end());
  *(sof + 1) = 0xC1;

  for (int scale : {1, 2, 4, 8}) {
    for (auto type : {image::IMAGE_TYPE_RGB565, image::IMAGE_TYPE_RGB}) {
      SourceImage baseline(type, 48 / scale, 40 / scale);
      ASSERT_TRUE(decode_fed(baseline));
      ASSERT_EQ(baseline.scale(), scale);

      SourceImage fed(type, 48 / scale, 40 / scale);
      ASSERT_TRUE(decode_fed(fed, extended.data(), extended.size()));
      EXPECT_EQ(pixels(fed), pixels(baseline)) << "fed, scale " << scale << ", image type " << type;

      SourceImage stepped(type, 48 / scale, 40 / scale);
      MemorySource source(extended.data(), extended.size());
      int steps;
      ASSERT_EQ(decode_stepped(stepped, source, steps, extended.size()), DECODE_STEP_DONE);
      ASSERT_EQ(stepped.scale(), scale);
      EXPECT_EQ(pixels(stepped), pixels(baseline)) << "stepped, scale " << scale << ", image type " << type;
    }
  }
}

TEST(JpegSourceDecode, ProgressiveImageWaitsForDataThatHasNotArrived) {
  SourceImage baseline;
  ASSERT_TRUE(decode_fed(baseline));

  // Enough for the headers (the first scan starts at byte 230); more arrives only when the decode asks for it
  SourceImage img;
  TrickleSource source(JPEG_ROWS_PROGRESSIVE, sizeof(JPEG_ROWS_PROGRESSIVE), 300);
  ASSERT_TRUE(img.begin_decode(sizeof(JPEG_ROWS_PROGRESSIVE)));
  ASSERT_EQ(img.begin_source(&source), 0);
  int waits = 0;
  int steps = 0;
  int result;
  while ((result = img.decode_step()) == DECODE_STEP_MORE || result == DECODE_STEP_NEED_DATA) {
    if (result == DECODE_STEP_NEED_DATA) {
      waits++;
      source.deliver(50);
    }
    ASSERT_LT(++steps, 1000);
  }
  ASSERT_EQ(result, DECODE_STEP_DONE);
  ASSERT_TRUE(img.end_decode());
  EXPECT_GT(waits, 0);
  EXPECT_EQ(pixels(img), pixels(baseline));
}

// The coefficient buffer of a progressive image is freed with the image, so the decoder can be used again
TEST(JpegSourceDecode, ReleasePartWayThroughAProgressiveImageLetsTheNextDecodeStart) {
  SourceImage img;
  MemorySource first(JPEG_ROWS_PROGRESSIVE, sizeof(JPEG_ROWS_PROGRESSIVE));
  ASSERT_TRUE(img.begin_decode(sizeof(JPEG_ROWS_PROGRESSIVE)));
  ASSERT_EQ(img.begin_source(&first), 0);
  ASSERT_EQ(img.decode_step(), DECODE_STEP_MORE);
  img.release();

  MemorySource second(JPEG_ROWS_PROGRESSIVE, sizeof(JPEG_ROWS_PROGRESSIVE));
  int steps;
  EXPECT_EQ(decode_stepped(img, second, steps, sizeof(JPEG_ROWS_PROGRESSIVE)), DECODE_STEP_DONE);
}

TEST(JpegSourceDecode, CompletedDecodeCountsTheWholeImage) {
  SourceImage img;
  MemorySource source(JPEG_ROWS, sizeof(JPEG_ROWS));
  ASSERT_TRUE(img.begin_decode(sizeof(JPEG_ROWS)));
  ASSERT_EQ(img.begin_source(&source), 0);
  int result;
  while ((result = img.decode_step()) == DECODE_STEP_MORE) {
    EXPECT_EQ(img.decoded_bytes(), 0u);
  }
  ASSERT_EQ(result, DECODE_STEP_DONE);
  EXPECT_EQ(img.decoded_bytes(), sizeof(JPEG_ROWS));
}

TEST(JpegSourceDecode, SourceIsReadAsTheDecodeNeedsIt) {
  SourceImage img;
  MemorySource source(JPEG_ROWS, sizeof(JPEG_ROWS));
  int steps;
  ASSERT_EQ(decode_stepped(img, source, steps), DECODE_STEP_DONE);
  EXPECT_GE(source.reads, 2);
}

TEST(JpegSourceDecode, DecodersThatCannotReadASourceSaySo) {
  RuntimeImage img(BMP, image::IMAGE_TYPE_RGB, image::TRANSPARENCY_OPAQUE);
  ASSERT_TRUE(img.begin_decode(100));
  EXPECT_FALSE(img.decoder_supports_source());
  MemorySource source(JPEG_ROWS, sizeof(JPEG_ROWS));
  EXPECT_EQ(img.begin_source(&source), DECODE_ERROR_UNSUPPORTED_FORMAT);
  EXPECT_EQ(img.decode_step(), DECODE_ERROR_UNSUPPORTED_FORMAT);
}

TEST(JpegSourceDecode, SourceNeedsTheImageSize) {
  SourceImage img;
  MemorySource source(JPEG_ROWS, sizeof(JPEG_ROWS));
  // JPEGDEC needs the file size up front, and holds it in an int
  ASSERT_TRUE(img.begin_decode(0));
  EXPECT_EQ(img.begin_source(&source), DECODE_ERROR_INVALID_TYPE);
  img.release();
  ASSERT_TRUE(img.begin_decode(static_cast<size_t>(INT32_MAX) + 1));
  EXPECT_EQ(img.begin_source(&source), DECODE_ERROR_INVALID_TYPE);
}

TEST(JpegSourceDecode, StepWithoutADecodeIsRefused) {
  SourceImage img;
  EXPECT_EQ(img.decode_step(), DECODE_ERROR_INVALID_TYPE);
  ASSERT_TRUE(img.begin_decode(sizeof(JPEG_ROWS)));
  // begin_source() was never called
  EXPECT_EQ(img.decode_step(), DECODE_ERROR_INVALID_TYPE);
}

}  // namespace esphome::runtime_image::testing

#endif  // USE_RUNTIME_IMAGE_JPEG
