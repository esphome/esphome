/**
 * Author: SeeedStudio
 * Link: https://github.com/Seeed-Studio/Seeed_Arduino_24GHz_Radar_Sensor
 * Accessed: 5/7/2023
 * License: MIT
 */
#include "radar.h"
#include <stdint.h>

namespace esphome {
namespace mr24d11c10 {

const uint8_t MESSAGE_HEAD = 0x55;
const uint8_t ACTIVE_REPORT = 0x04;
const uint8_t FALL_REPORT = 0x06;

const uint8_t REPORT_RADAR = 0x03;
const uint8_t REPORT_OTHER = 0x05;

const uint8_t HEARTBEAT = 0x01;
const uint8_t ABNOEMAL = 0x02;
const uint8_t ENVIRONMENT = 0x05;
const uint8_t BODYSIGN = 0x06;
const uint8_t CLOSE_AWAY = 0x07;

const uint8_t CA_BE = 0x01;
const uint8_t CA_CLOSE = 0x02;
const uint8_t CA_AWAY = 0x03;
const uint8_t SOMEBODY_BE = 0x01;
const uint8_t SOMEBODY_MOVE = 0x01;
const uint8_t SOMEBODY_STOP = 0x00;
const uint8_t NOBODY = 0x00;

const unsigned char cuc_CRCHi[256] = {
    0x00, 0xC1, 0x81, 0x40, 0x01, 0xC0, 0x80, 0x41, 0x01, 0xC0, 0x80, 0x41, 0x00, 0xC1, 0x81, 0x40, 0x01, 0xC0, 0x80,
    0x41, 0x00, 0xC1, 0x81, 0x40, 0x00, 0xC1, 0x81, 0x40, 0x01, 0xC0, 0x80, 0x41, 0x01, 0xC0, 0x80, 0x41, 0x00, 0xC1,
    0x81, 0x40, 0x00, 0xC1, 0x81, 0x40, 0x01, 0xC0, 0x80, 0x41, 0x00, 0xC1, 0x81, 0x40, 0x01, 0xC0, 0x80, 0x41, 0x01,
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    0x41, 0x01, 0xC0, 0x80, 0x41, 0x00, 0xC1, 0x81, 0x40};

const unsigned char cuc_CRCLo[256] = {
    0x00, 0xC0, 0xC1, 0x01, 0xC3, 0x03, 0x02, 0xC2, 0xC6, 0x06, 0x07, 0xC7, 0x05, 0xC5, 0xC4, 0x04, 0xCC, 0x0C, 0x0D,
    0xCD, 0x0F, 0xCF, 0xCE, 0x0E, 0x0A, 0xCA, 0xCB, 0x0B, 0xC9, 0x09, 0x08, 0xC8, 0xD8, 0x18, 0x19, 0xD9, 0x1B, 0xDB,
    0xDA, 0x1A, 0x1E, 0xDE, 0xDF, 0x1F, 0xDD, 0x1D, 0x1C, 0xDC, 0x14, 0xD4, 0xD5, 0x15, 0xD7, 0x17, 0x16, 0xD6, 0xD2,
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    0x86, 0x82, 0x42, 0x43, 0x83, 0x41, 0x81, 0x80, 0x40};

unsigned short int us_CalculateCrc16(unsigned char *lpuc_Frame, unsigned short int lus_Len) {
  unsigned char luc_CRCHi = 0xFF;
  unsigned char luc_CRCLo = 0xFF;
  int li_Index = 0;
  while (lus_Len--) {
    li_Index = luc_CRCLo ^ *(lpuc_Frame++);
    luc_CRCLo = (unsigned char) (luc_CRCHi ^ cuc_CRCHi[li_Index]);
    luc_CRCHi = cuc_CRCLo[li_Index];
  }
  return (unsigned short int) (luc_CRCLo << 8 | luc_CRCHi);
}

char radar::CRC(char ad1, char ad2, char ad3, char ad4, char ad5, char ad6, char ad7) {
  unsigned char data[] = {ad1, ad2, ad3, ad4, ad5, ad6, ad7};
  unsigned short int crc_data = 0x0000;
  unsigned int lenth = sizeof(data) / sizeof(unsigned char);
  crc_data = us_CalculateCrc16(data, lenth);
  return crc_data;
}

typedef union {
  unsigned char Byte[4];
  float Float;
} Float_Byte;

int radar::Bodysign_val(int ad1, int ad2, int ad3, int ad4, int ad5) {
  if (ad1 == BODYSIGN) {
    Float_Byte fb;
    fb.Byte[0] = ad2;
    fb.Byte[1] = ad3;
    fb.Byte[2] = ad4;
    fb.Byte[3] = ad5;
    return fb.Float;
  }
  return 0;
}

int radar::Situation_judgment(int ad1, int ad2, int ad3, int ad4, int ad5) {
  int result = 0;
  if (ad1 == REPORT_RADAR || ad1 == REPORT_OTHER) {
    if (ad2 == ENVIRONMENT || ad2 == HEARTBEAT) {
      if (ad3 == NOBODY) {
        result = 1;
      } else if (ad3 == SOMEBODY_BE && ad4 == SOMEBODY_MOVE) {
        result = 2;
      } else if (ad3 == SOMEBODY_BE && ad4 == SOMEBODY_STOP) {
        result = 3;
      }
    } else if (ad2 == CLOSE_AWAY) {
      if (ad3 == CA_BE && ad4 == CA_BE) {
        if (ad5 == CA_BE) {
          result = 4;
        } else if (ad5 == CA_CLOSE) {
          result = 5;
        } else if (ad5 == CA_AWAY) {
          result = 6;
        }
      }
    }
  }
  return result;
}

int radar::Fall_judgment(int ad1, int ad2, int ad3, int ad4) {
  int result = 0;
  if (ad1 == FALL_REPORT && ad2 == 0x01) {
    if (ad3 == 0x01) {
      if (ad4 == 0x00) {
        result = 1;
      } else if (ad4 == 0x01) {
        result = 2;
      } else if (ad4 == 0x02) {
        result = 3;
      }
    } else if (ad3 == 0x02) {
      if (ad4 == 0x00) {
        result = 4;
      } else if (ad4 == 0x01) {
        result = 5;
      } else if (ad4 == 0x02) {
        result = 6;
      } else if (ad4 == 0x03) {
        result = 7;
      } else if (ad4 == 0x04) {
        result = 8;
      }
    }
  }
  return result;
}

}  // namespace mr24d11c10
}  // namespace esphome
/** END of copied and changed content */
